/*
 * dts file for Centec CTC5236(TsingMa) SoC
 *
 * (C) Copyright 2004-2017 Centec Networks (suzhou) Co., LTD.
 *
 * Jay Cao <caoj@centecnetworks.com>
 *
 * This program is free software; you can redistribute it and/or
 * modify it under the terms of the GNU General Public License as
 * published by the Free Software Foundation; either version 2 of
 * the License, or (at your option) any later version.
 */

	osc: oscillator {
		#clock-cells = <0>;
		compatible = "fixed-clock";
		clock-frequency = <25000000>;
        };

	sup_clk: sup_clk_300m {
		#clock-cells = <0>;
		compatible = "fixed-clock";
		clock-frequency = <300000000>;
		clock-output-names = "sup_clk";
        };

	uart_clk: uat_clk_300m {
		#clock-cells = <0>;
		compatible = "fixed-clock";
		clock-frequency = <300000000>;
		clock-output-names = "uart_clk";
        };

	i2c_clk: clkm {
		#clock-cells = <0>;
		compatible = "fixed-clock";
		clock-frequency = <50000000>;
		clock-output-names = "i2c_clk";
        };
