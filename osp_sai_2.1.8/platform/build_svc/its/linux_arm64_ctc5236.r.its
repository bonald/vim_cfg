## osp_sai_2.1.8/platform/build_svc/its/linux_arm64_ctc5236.r.its
```
/*
 *Copyright 2018 CENTEC
 *
 */

/dts-v1/;

/ {
	description = "arm64 kernel, initramfs and FDT blob";	
	#address-cells = <1>;
    
	images {
		kernel_ctc {
			description = "ARM64 Kernel";			
			data = /incbin/("../../../out.e530/kbuild.ctc5236.r/arch/arm64/boot/Image.gz");			
			type = "kernel";			
			arch = "arm64";			
			os = "linux";			
			compression = "gzip";			
			load = <0x80080000>;			
			entry = <0x80080000>;			
			hash {				
				algo = "crc32";			
			};
		};
		initramfs {
			description = "initramfs";
			data = /incbin/("../../../out.e530/kbuild.ctc5236.r/mini_initramfs.lzma");
			type = "ramdisk";
			arch = "arm64";
			os = "linux";
			compression = "gzip";
			load = <0x85000000>;
			entry = <0x85000000>;
			hash {				
				algo = "crc32";			
			};
		};
		ctc_fdt {
			description = "dtb for tm_ctc5236";			
			data = /incbin/("../../../out.e530/kbuild.ctc5236.r/arch/arm64/boot/dts/centec/e530-ctc5236.dtb");			
			type = "flat_dt";
			arch = "arm64";			
			os = "linux";			
			compression = "none";			
			load = <0x88000000>;			
			hash {				
				algo = "crc32";			
			};
		};
	};
	configurations {
		default = "e530-24x2c";
					
		e530-24x2c {			
			description = "config for tm_ctc5236";			
			kernel = "kernel_ctc";			
			ramdisk = "initramfs";			
			fdt = "ctc_fdt";		
			};
					
		tm_ctc5236 {			
			description = "config for tm_ctc5236";			
			kernel = "kernel_ctc";			
			ramdisk = "initramfs";			
			fdt = "ctc_fdt";		
			};
	};
};
```

## osp_sai_2.1.8/platform/build_svc/its/linux_arm64_ls1023a_duet2.d.its
```
/*
 * Copyright 2017 NXP
 *
 */


/dts-v1/;

/ {
	description = "arm64 kernel, ramdisk and FDT blob";
	#address-cells = <1>;

	images {
		kernel {
			description = "ARM64 Kernel";
			data = /incbin/("../../../out.e550/kbuild.ls1023a.d/arch/arm64/boot/Image.gz");
			type = "kernel";
			arch = "arm64";
			os = "linux";
			compression = "gzip";
			load = <0x80080000>;
			entry = <0x80080000>;
			hash@1 {
				algo = "crc32";
			};
		};

		initrd-installer {
			description = "initrd for installer";
			data = /incbin/("../../../out.e550/kbuild.ls1023a.d/mini_initramfs.lzma");
			type = "ramdisk";
			arch = "arm64";
			os = "linux";
			compression = "lzma";
			load = <0x00000000>;
			entry = <0x00000000>;
			hash@1 {
				algo = "crc32";
			};
		};

		fsl-ls1023a-ctc {
			description = "fsl-ls1023a-ctc";
			data = /incbin/("../../../out.e550/kbuild.ls1023a.d/arch/arm64/boot/dts/freescale/fsl-ls1023a-ctc.dtb");
			type = "flat_dt";
			arch = "arm64";
			os = "linux";
			compression = "none";
			load = <0x90000000>;
			hash@1 {
				algo = "crc32";
			};
		};
	};

	configurations {
		ctc_ls1023a {
			description = "config for ls1023a-ctc";
			kernel = "kernel";
			ramdisk = "initrd-installer";
			fdt = "fsl-ls1023a-ctc";
		};
	};
};
```

## osp_sai_2.1.8/platform/build_svc/its/linux_arm64_ls1023a_tsingma.r.its
```
/*
 *Copyright 2018 CENTEC
 *
 */

/dts-v1/;

/ {
	description = "arm64 kernel, initramfs and FDT blob";	
	#address-cells = <1>;
    
	images {
		kernel {
			description = "ARM64 Kernel";			
			data = /incbin/("../../../out.e530/kbuild.ls1023a.r/arch/arm64/boot/Image.gz");			
			type = "kernel";			
			arch = "arm64";			
			os = "linux";			
			compression = "gzip";			
			load = <0x80080000>;			
			entry = <0x80080000>;			
			hash {				
				algo = "crc32";			
			};
		};

		initrd-installer {
			description = "initrd for installer";
			data = /incbin/("../../../out.e530/kbuild.ls1023a.r/mini_initramfs.lzma");
			type = "ramdisk";
			arch = "arm64";
			os = "linux";
			compression = "lzma";
			load = <0x00000000>;
			entry = <0x00000000>;
			hash {				
				algo = "crc32";			
			};
		};

		fsl-ls1023a-ctc {
			description = "fsl-ls1023a-ctc";
			data = /incbin/("../../../out.e530/kbuild.ls1023a.r/arch/arm64/boot/dts/freescale/fsl-ls1023a-ctc.dtb");
			type = "flat_dt";
			arch = "arm64";			
			os = "linux";			
			compression = "none";			
			load = <0x90000000>;
			hash {				
				algo = "crc32";			
			};
		};
	};
	configurations {
		ctc_ls1023a {
			description = "config for ls1023a-ctc";
			kernel = "kernel";
			ramdisk = "initrd-installer";
			fdt = "fsl-ls1023a-ctc";
		};
	};
};
```

## osp_sai_2.1.8/platform/linux-4.9.62/drivers/net/ethernet/centec/Kconfig
```kconfig
#
# Centec network device configuration
#

config NET_VENDOR_CENTEC
        bool "centec cpumac"
        default n
        ---help---
          If you have a network (Ethernet) card belonging to this class, say Y.
```

## osp_sai_2.1.8/platform/linux-4.9.62/drivers/soc/centec/Kconfig
```kconfig
if ARCH_ROCKCHIP || COMPILE_TEST

#
# Rockchip Soc drivers
#
config ARCH_CTC5236
        help
        
endif
```
